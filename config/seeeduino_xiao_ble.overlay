&i2c1 {
    status = "okay";
    compatible = "nordic,nrf-twi";
    sda-pin = <4>;
    scl-pin = <5>;
    clock-frequency = <I2C_BITRATE_FAST>;

    pmw3610@0x00 {
        compatible = "zmk,input-sensor-trackball";
        reg = <0x00>;
        label = "PMW3610";

        input-remap {
            compatible = "zmk,input-remap-trackball";
            x-negative = <&trackball_left>;
            x-positive = <&trackball_right>;
            y-negative = <&trackball_up>;
            y-positive = <&trackball_down>;
        };
    };
};
