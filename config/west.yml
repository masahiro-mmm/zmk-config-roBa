## config/west.yml
```yaml
manifest:
  remotes:
    - name: zmkfirmware
      url-base: https://github.com/zmkfirmware
  projects:
    - name: zmk
      remote: zmkfirmware
      revision: main        # 必要なら v0.2 などに固定
      import: app/west.yml
  self:
    path: config
```
